## Kconfig
```kconfig
# Sensor data simulator
#
# Copyright (c) 2019 Nordic Semiconductor
#
# SPDX-License-Identifier: LicenseRef-Nordic-5-Clause
#

menuconfig PMW3610
    bool "PMW3610 mouse optical sensor"
  select SPI
    help
      Enable PMW3610 mouse optical sensor.

if PMW3610

config PMW3610_SMART_ALGORITHM
  bool "Enable an algorithm of PMW3610 to enhance surface coverage"
  default y
  help
    Enable the integration of the smart algorithm as the datasheet implementation.
    The algorithm is used to extend the tracking acrocss a wider range of surfaces
    such as graniles and tiles.

config PMW3610_CPI
    int "PMW3610's default CPI"
    default 800
    range 200 3200
    help
      Default CPI value, with 200 step

config PMW3610_CPI_DIVIDOR
    int "PMW3610's default CPI dividor"
    default 1
    range 1 100
    help
      Default CPI dividor value.

config PMW3610_SNIPE_CPI
    int "PMW3610's CPI in snipe mode"
    default 200
    range 200 3200
    help
      Snipe CPI value, with 200 step

config PMW3610_SNIPE_CPI_DIVIDOR
    int "PMW3610's CPI dividor in snipe mode"
    default 1
    range 1 100
    help
      Snipe CPI dividor value.

config PMW3610_SCROLL_TICK
    int "PMW3610's required ticks to produce a scroll report"
    default 20
    help
      Scroll tick value.

choice
    prompt "Select PMW3610's polling rate"
    default PMW3610_POLLING_RATE_250

config PMW3610_POLLING_RATE_250
    bool "250 Hz"

config PMW3610_POLLING_RATE_125
    bool "125 Hz"

config PMW3610_POLLING_RATE_125_SW
    bool "125 Hz with software implementation"

config PMW3610_POLLING_RATE_100
    bool "100 Hz (recommended for Bluetooth)"

config PMW3610_POLLING_RATE_50
    bool "50 Hz (for Bluetooth optimization)"

endchoice

config PMW3610_BLUETOOTH_OPTIMIZATION
    bool "Enable Bluetooth-specific optimizations"
    default y
    help
      Enable optimizations specifically for Bluetooth connections to reduce latency
      and improve performance on macOS and other Bluetooth hosts.

config PMW3610_MOTION_THRESHOLD
    int "Motion threshold for Bluetooth optimization"
    default 2
    range 1 10
    depends on PMW3610_BLUETOOTH_OPTIMIZATION
    help
      Minimum motion value to trigger a report when using Bluetooth optimization.
      Higher values reduce sensitivity but improve performance.

config PMW3610_BT_BATCH_SIZE
    int "Batch size for Bluetooth motion reports"
    default 3
    range 1 5
    depends on PMW3610_BLUETOOTH_OPTIMIZATION
    help
      Number of motion samples to batch before sending a report over Bluetooth.
      Higher values reduce Bluetooth traffic but may increase latency.

config PMW3610_SMOOTH_MOTION
    bool "Enable motion smoothing for smoother cursor movement"
    default y
    depends on PMW3610_BLUETOOTH_OPTIMIZATION
    help
      Enable motion smoothing to reduce jerky movement on Bluetooth connections.
      Uses interpolation to create smoother cursor movement.

config PMW3610_SMOOTH_FACTOR
    int "Motion smoothing factor"
    default 8
    range 1 20
    depends on PMW3610_SMOOTH_MOTION
    help
      Higher values create smoother but more delayed movement.
      Lower values are more responsive but may be jerky.

config PMW3610_ADAPTIVE_BATCHING
    bool "Enable adaptive motion batching"
    default y
    depends on PMW3610_BLUETOOTH_OPTIMIZATION
    help
      Dynamically adjust batch size based on motion speed.
      Faster movements use smaller batches for responsiveness.

config PMW3610_FORCE_AWAKE
    bool "PMW3610 forced awake mode"
    help
      This setting forces the sensor to always be in the RUN state.

config PMW3610_RUN_DOWNSHIFT_TIME_MS
    int "PMW3610's default RUN mode downshift time"
    default 128
    range 13 3264
    help
      Default RUN mode downshift down time in milliseconds.
      Time after which sensor goes from RUN to REST1 mode.

config PMW3610_REST1_SAMPLE_TIME_MS
    int "PMW3610's sample time in REST1 stage"
    default 40
    range 10 2550
    help
      Default REST1 mode sample period in millisecond

config PMW3610_REST1_DOWNSHIFT_TIME_MS
    int "PMW3610's default REST1 mode downshift time"
    default 9600
    help
      Default REST1 mode downshift down time in milliseconds.
      Time after which sensor goes from REST1 to REST2 mode.

config PMW3610_REST2_SAMPLE_TIME_MS
    int "PMW3610's sample time in REST2 stage"
    default 0
    range 0 2550
    help
      Default REST2 mode sample period in millisecond.
      Minimum value is 10.
      No optimal value provided by datasheet.

config PMW3610_REST2_DOWNSHIFT_TIME_MS
    int "PMW3610's default REST2 mode downshift time"
    default 0
    help
      Default REST2 mode downshift down time in milliseconds.
      Time after which sensor goes from REST2 to REST3 mode.
      No optimal value provided by datasheet.

config PMW3610_REST3_SAMPLE_TIME_MS
    int "PMW3610's sample time in REST3 stage"
    default 0
    range 0 2550
    help
      Default REST2 mode sample period in millisecond.
      Minimum value is 10.
      No optimal value provided by datasheet.

config PMW3610_ACTIVE_LAYER
    int "Layer to activate when trackball is enabled"
    default 5
    help
      Specifies which layer should be activated when the trackball is enabled.

config PMW3610_DEACTIVE_LAYER
    int "Layer to activate when trackball is disabled"
    default 0
    help
      Specifies which layer should be activated when the trackball is disabled.

config PMW3610_ACCELERATION_THRESHOLD
    int "Acceleration threshold for mouse movement"
    default 5
    help
      The threshold at which mouse acceleration begins to take effect.

choice
    prompt "Select PMW3610 sensor orientation"
    default PMW3610_ORIENTATION_0

config PMW3610_ORIENTATION_0
    bool "PMW3610 not rotated"

config PMW3610_ORIENTATION_90
    bool "PMW3610 rotated 90 deg clockwise"

config PMW3610_ORIENTATION_180
    bool "PMW3610 rotated 180 deg clockwise"

config PMW3610_ORIENTATION_270
    bool "PMW3610 rotated 270 deg clockwise"

endchoice

config PMW3610_INVERT_X
  bool "Invert the X axis of PMW3610 sensor"

config PMW3610_INVERT_Y
  bool "Invert the Y axis of PMW3610 sensor"

config PMW3610_INVERT_SCROLL_X
  bool "Invert the X axis of the scroll"
  default PMW3610_INVERT_X

config PMW3610_INVERT_SCROLL_Y
  bool "Invert the Y axis of the scroll"
  default PMW3610_INVERT_Y

config PMW3610_AUTOMOUSE_TIMEOUT_MS
  int "Amount of milliseconds the mouse layer will be active after using the trackball"
  default 400

module = PMW3610
module-str = PMW3610
source "${ZEPHYR_BASE}/subsys/logging/Kconfig.template.log_config"

endif #PMW3610
```
